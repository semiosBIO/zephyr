## drivers/adc/Kconfig.ambiq
```kconfig
# ADC configuration options

# Copyright (c) 2024 Semios Inc
# SPDX-License-Identifier: Apache-2.0

config ADC_AMBIQ
	bool "Ambiq ADC driver"
	default y
	depends on DT_HAS_AMBIQ_ADC_ENABLED
	select AMBIQ_HAL
	select AMBIQ_HAL_USE_ADC
	select ADC_CONFIGURABLE_INPUTS
	help
	  Enable support for Ambiq ADC driver for Apollo3 MCU series.
```

## drivers/flash/Kconfig.ambiq
```kconfig
# Copyright (c) 2023 Ambiq Micro Inc.
# SPDX-License-Identifier: Apache-2.0

config FLASH_AMBIQ_APOLLO4
	bool "Ambiq flash driver on MRAM"
	default y
	depends on DT_HAS_AMBIQ_FLASH_CONTROLLER_ENABLED
	depends on SOC_SERIES_APOLLO4X
	select AMBIQ_HAL
	select FLASH_HAS_PAGE_LAYOUT
	select FLASH_HAS_DRIVER_ENABLED
	help
	  Enables Ambiq flash driver on MRAM.

config FLASH_AMBIQ_APOLLO3
	bool "Ambiq flash driver"
	default y
	depends on DT_HAS_AMBIQ_FLASH_CONTROLLER_ENABLED
	depends on SOC_SERIES_APOLLO3X
	select AMBIQ_HAL
	select FLASH_HAS_PAGE_LAYOUT
	select FLASH_HAS_DRIVER_ENABLED
	help
	  Enables Ambiq flash driver on MRAM.
```

## drivers/rtc/Kconfig.ambiq
```kconfig
# Copyright 2024 Semios Inc
# SPDX-License-Identifier: Apache-2.0

config RTC_AMBIQ
	bool "Ambiq RTC driver"
	default y
	depends on DT_HAS_AMBIQ_RTC_ENABLED && !SOC_SERIES_APOLLO4X
	help
	  Build RTC driver for Ambiq SoCs, excluding Apollo4 series.
```

## drivers/serial/Kconfig.sc16is7xx
```kconfig
# Copyright (c) 2024 Semios
# SPDX-License-Identifier: Apache-2.0

menu "SC16IS7XX UART"
config UART_SC16IS7XX
	bool "SC16IS7XX Dual UART"
	default n
	select I2C
	help
	  Enable driver for SC16IS7XX Dual UART.

# for logging levels
module = UART_SC16IS7XX
module-str = sc16is7xx i2c uart
source "subsys/logging/Kconfig.template.log_config"

endmenu
```

## dts/bindings/adc/ambiq,adc.yaml
```yaml
# Copyright (c) 2024 Semios Inc
# SPDX-License-Identifier: Apache-2.0

description: Ambiq ADC node

compatible: "ambiq,adc"

include: [adc-controller.yaml, pinctrl-device.yaml, ambiq-pwrcfg.yaml]

properties:
  pinctrl-0:
    required: true

  reg:
    required: true

  interrupts:
    required: true

  "#io-channel-cells":
    const: 1

  ambiq,pwrcfg:
    required: true

  ambiq,adc-reference:
    type: int
    default: 0
    enum:
      - 0 # Internal reference
      - 1 # External reference 0
      - 2 # External reference 1
    description: |
      Reference sources for the ADC. A single internal and two external
      references are available.

  ambiq,vref-mv:
    type: int
    default: 2200
    enum:
      - 1500
      - 2200
    description: |
      ADC reference voltage. Only a fixed set of refernce voltages are
      supported by the ApolloX MCUs for both internal and external ADC
      reference sources.

io-channel-cells:
  - input
```

## dts/bindings/counter/ambiq,counter.yaml
```yaml
# Copyright (c) 2023 Antmicro <www.antmicro.com>
# SPDX-License-Identifier: Apache-2.0

description: Ambiq Timer/Counter

compatible: "ambiq,counter"

include: base.yaml

properties:
  reg:
    required: true

  interrupts:
    required: true

  timer:
    required: true
    type: int
    description: Timer number

  counter_clock:
    required: true
    type: int
    description: Clock source
    enum:
      - 0 # AM_HAL_CTIMER_CLK_PIN
      - 1 # AM_HAL_CTIMER_HFRC_12MHZ
      - 2 # AM_HAL_CTIMER_HFRC_3MHZ
      - 3 # AM_HAL_CTIMER_HFRC_187_5KHZ
      - 4 # AM_HAL_CTIMER_HFRC_47KHZ
      - 5 # AM_HAL_CTIMER_HFRC_12KHZ
      - 6 # AM_HAL_CTIMER_XT_32_768KHZ
      - 7 # AM_HAL_CTIMER_XT_16_384KHZ
      - 8 # AM_HAL_CTIMER_XT_2_048KHZ
      - 9 # AM_HAL_CTIMER_XT_256HZ
      - 10 # AM_HAL_CTIMER_LFRC_512HZ
      - 11 # AM_HAL_CTIMER_LFRC_32HZ
      - 12 # AM_HAL_CTIMER_LFRC_1HZ
      - 13 # AM_HAL_CTIMER_LFRC_1_16HZ
      - 14 # AM_HAL_CTIMER_RTC_100HZ

  counter_function:
    required: true
    type: int
    description: Counter function pattern
    enum:
      - 0 # AM_HAL_CTIMER_FN_ONCE
      - 1 # AM_HAL_CTIMER_FN_REPEAT
      - 2 # AM_HAL_CTIMER_FN_PWM_ONCE
      - 3 # AM_HAL_CTIMER_FN_PWM_REPEAT
      - 4 # AM_HAL_CTIMER_FN_PTN_ONCE
      - 5 # AM_HAL_CTIMER_FN_PTN_REPEAT
      - 6 # AM_HAL_CTIMER_FN_CONTINUOUS
      - 7 # AM_HAL_CTIMER_FN_PWM_ALTERNATE
```

## dts/bindings/rtc/ambiq,rtc.yaml
```yaml
# Copyright (c) 2024 Semios Inc
# SPDX-License-Identifier: Apache-2.0

description: Ambiq RTC

compatible: "ambiq,rtc"

include: rtc-device.yaml

properties:
  reg:
    required: true
```
